## CMakeLists.txt
```
# SPDX-License-Identifier: Apache-2.0

cmake_minimum_required(VERSION 3.20.0)
find_package(Zephyr REQUIRED HINTS $ENV{ZEPHYR_BASE})
project(initiator)

file(GLOB app_sources src/*.c src/bluetooth/*.c src/logic_manager/*.c)

target_sources(app PRIVATE ${app_sources})

zephyr_library_include_directories(
        ${CMAKE_CURRENT_LIST_DIR}/include
)
```

## prj.conf
```kconfig
CONFIG_BT=y
CONFIG_BT_PERIPHERAL=y
CONFIG_BT_SMP=y
CONFIG_BT_CENTRAL=y
CONFIG_BT_GAP_AUTO_UPDATE_CONN_PARAMS=n
CONFIG_BT_AUTO_PHY_UPDATE=n
CONFIG_BT_GATT_CLIENT=y
CONFIG_BT_GATT_DYNAMIC_DB=y
CONFIG_BT_ATT_PREPARE_COUNT=3
CONFIG_BT_CHANNEL_SOUNDING=y

CONFIG_BT_BUF_ACL_RX_SIZE=251
CONFIG_BT_BUF_ACL_TX_SIZE=251
CONFIG_BT_L2CAP_TX_MTU=247

CONFIG_MAIN_STACK_SIZE=4096

CONFIG_CBPRINTF_FP_SUPPORT=y

CONFIG_LOG=y
```

## src/main.c
```c
/*
 * Copyright (c) 2024 Nordic Semiconductor ASA
 *
 * SPDX-License-Identifier: Apache-2.0
 */

#include <math.h>
#include <zephyr/sys/byteorder.h>
#include <zephyr/bluetooth/bluetooth.h>
#include <zephyr/bluetooth/cs.h>
#include <zephyr/bluetooth/att.h>
#include <zephyr/bluetooth/gatt.h>
#include "distance_estimation.h"
#include "bluetooth_global.h"
#include "bluetooth_reflector.h"
#include "bluetooth_initiator.h"
#include <zephyr/logging/log.h>
#include "logic_main.h"
#include "bluetooth_device_control.h"
#include "bluetooth_anchor.h"

static bool anchor = false; 
LOG_MODULE_REGISTER(main);

int main(void)
{
	int err;

    logic_thread_init();
    mark_as_anchor(anchor);
	LOG_INF("Starting Channel Sounding Demo");

	err = ble_init();
    if (err) 
        LOG_ERR("Failed in ble init (err %d)", err);

    is_initiator(anchor);

    if(anchor)
        err = act_as_anchor();

    if(!anchor){
        // send_message(MESSAGE_SETUP_DEVICE, 1);
        while(1){
            k_sleep(K_SECONDS(10));
        }
    }
}
// bt_unpair(BT_ID_DEFAULT, BT_ADDR_LE_ANY);
```

## include/bluetooth_anchor.h
```c
#ifndef BT_ANCHOR_H
#define BT_ANCHOR_H

#include <zephyr/sys/byteorder.h>
#include <zephyr/bluetooth/bluetooth.h>
#include <zephyr/bluetooth/cs.h>
#include <zephyr/bluetooth/att.h>
#include <zephyr/bluetooth/gatt.h>

int act_as_anchor(void);

#endif
```

## include/bluetooth_device_control.h
```c
#ifndef BT_DEVICE_CONTROL_H
#define BT_DEVICE_CONTROL_H

#include <zephyr/logging/log.h>
#include <zephyr/sys/byteorder.h>
#include <zephyr/bluetooth/bluetooth.h>
#include <zephyr/bluetooth/cs.h>
#include <zephyr/bluetooth/att.h>
#include <zephyr/bluetooth/gatt.h>
#include <zephyr/sys/byteorder.h>

enum device_setting
{
    SETTING_REFLECTOR = 0,
    SETTING_REFLECTOR_DELAY,
    SETTING_INITIATOR,
    SETTING_COUNT

};

int register_logic_gatt_service(void);
int discover_logic_gatt_service(struct bt_conn* conn);
int logic_gatt_write(struct bt_conn *conn, uint8_t data);
int logic_gatt_notify(uint8_t value);

#endif
```

## include/bluetooth_global.h
```c
#ifndef BT_GLOBAL_H
#define BT_GLOBAL_H

#include <zephyr/sys/byteorder.h>
#include <zephyr/bluetooth/bluetooth.h>
#include <zephyr/bluetooth/cs.h>
#include <zephyr/bluetooth/att.h>
#include <zephyr/bluetooth/gatt.h>
#include "distance_estimation.h"
#include "logic_main.h"

#define CS_CONFIG_ID     0
#define NUM_MODE_0_STEPS 1
#define NAME_LEN          30
#define STEP_DATA_BUF_LEN 512 /* Maximum GATT characteristic length */

enum connections
{
    CONNECTION_DEVICE = 0,
    CONNECTION_ANCHOR,
    CONNECTION_SERVER,
    CONNECTION_RESERVED,
    CONNECTION_RESERVED2,
    CONNECTIONS_MAX

};

int ble_init(void);

void is_initiator(bool is_init);
int register_step_data_gatt_service(void);
struct bt_conn* get_bt_connection(void);

struct k_sem* get_sem_acl_encryption_enabled(void);
struct k_sem* get_sem_remote_capabilities_obtained(void);
struct k_sem* get_sem_config_created(void);
struct k_sem* get_sem_cs_security_enabled(void);
struct k_sem* get_sem_procedure_done(void);
struct k_sem* get_sem_connected(void);
struct k_sem* get_sem_data_received(void);
uint8_t* get_latest_local_steps(void);
void call_estimate_distance(void);
int get_bt_le_cs_default_settings(bool is_reflector, struct bt_conn *connection);
int start_bt_scan(void);
int start_adv(void);
void mark_as_anchor(bool is_anchor);

#endif
```

## include/bluetooth_reflector.h
```c
#ifndef BT_REFLECTOR_H
#define BT_REFLECTOR_H

#include <zephyr/sys/byteorder.h>
#include <zephyr/bluetooth/bluetooth.h>
#include <zephyr/bluetooth/cs.h>
#include <zephyr/bluetooth/att.h>
#include <zephyr/bluetooth/gatt.h>
#include <zephyr/sys/byteorder.h>
#include "common.h"

int setup_reflector(bool wait);
struct bt_gatt_discover_params* get_discover_params(void);
int act_as_reflector(struct bt_conn* connection);
struct k_sem* get_sem_discovered(void);
struct k_sem* get_sem_written(void);

#endif
```

## include/common.h
```c
/*
 * Copyright (c) 2024 Nordic Semiconductor ASA
 *
 * SPDX-License-Identifier: Apache-2.0
 */

#ifndef COMMON_H
#define COMMON_H

#include <zephyr/bluetooth/gatt.h>

// #define NAME_LEN          30
// #define STEP_DATA_BUF_LEN 512 /* Maximum GATT characteristic length */

// static struct bt_uuid_128 step_data_char_uuid =
// 	BT_UUID_INIT_128(BT_UUID_128_ENCODE(0x87654321, 0x4567, 0x2389, 0x1254, 0xf67f9fedcba8));
// static const struct bt_uuid_128 step_data_svc_uuid =
// 	BT_UUID_INIT_128(BT_UUID_128_ENCODE(0x87654321, 0x4567, 0x2389, 0x1254, 0xf67f9fedcba9));

#endif
```

## include/cs_test_params.h
```c
/*
 * Copyright (c) 2024 Nordic Semiconductor ASA
 *
 * SPDX-License-Identifier: Apache-2.0
 */

#ifndef CS_PARAMS_H
#define CS_PARAMS_H

#include <zephyr/bluetooth/cs.h>

#define INITIATOR_ACCESS_ADDRESS 0x4D7B8A2F
#define REFLECTOR_ACCESS_ADDRESS 0x96F93DB1
#define NUM_MODE_0_STEPS         3

static struct bt_le_cs_test_param test_params_get(enum bt_conn_le_cs_role role)
{
	struct bt_le_cs_test_param params;

	params.role = role;
	params.main_mode = BT_CONN_LE_CS_MAIN_MODE_2;
	params.sub_mode = BT_CONN_LE_CS_SUB_MODE_1;
	params.main_mode_repetition = 1;
	params.mode_0_steps = NUM_MODE_0_STEPS;
	params.rtt_type = BT_CONN_LE_CS_RTT_TYPE_AA_ONLY;
	params.cs_sync_phy = BT_CONN_LE_CS_SYNC_1M_PHY;
	params.cs_sync_antenna_selection = BT_LE_CS_TEST_CS_SYNC_ANTENNA_SELECTION_ONE;
	params.subevent_len = 5000;
	params.subevent_interval = 0;
	params.max_num_subevents = 1;
	params.transmit_power_level = BT_HCI_OP_LE_CS_TEST_MAXIMIZE_TX_POWER;
	params.t_ip1_time = 145;
	params.t_ip2_time = 145;
	params.t_fcs_time = 150;
	params.t_pm_time = 40;
	params.t_sw_time = 0;
	params.tone_antenna_config_selection = BT_LE_CS_TONE_ANTENNA_CONFIGURATION_A1_B1;

	params.initiator_snr_control = BT_LE_CS_SNR_CONTROL_NOT_USED;
	params.reflector_snr_control = BT_LE_CS_SNR_CONTROL_NOT_USED;

	params.drbg_nonce = 0x1234;

	params.override_config = BIT(2) | BIT(5);
	params.override_config_0.channel_map_repetition = 1;

	memset(params.override_config_0.not_set.channel_map, 0, 10);

	for (uint8_t i = 40; i < 75; i++) {
		BT_LE_CS_CHANNEL_BIT_SET_VAL(params.override_config_0.not_set.channel_map, i, 1);
	}

	params.override_config_0.not_set.channel_selection_type = BT_CONN_LE_CS_CHSEL_TYPE_3B;
	params.override_config_0.not_set.ch3c_shape = BT_CONN_LE_CS_CH3C_SHAPE_HAT;
	params.override_config_0.not_set.ch3c_jump = 2;
	params.override_config_2.main_mode_steps = 8;
	params.override_config_5.cs_sync_aa_initiator = INITIATOR_ACCESS_ADDRESS;
	params.override_config_5.cs_sync_aa_reflector = REFLECTOR_ACCESS_ADDRESS;

	return params;
}

#endif
```

## include/distance_estimation.h
```c
/*
 * Copyright (c) 2024 Nordic Semiconductor ASA
 *
 * SPDX-License-Identifier: Apache-2.0
 */

#ifndef DISTANCE_ESTIMATION_H
#define DISTANCE_ESTIMATION_H

#include <stdint.h>
#include <zephyr/bluetooth/cs.h>

void estimate_distance(uint8_t *local_steps, uint16_t local_steps_len, uint8_t *peer_steps,
		       uint16_t peer_steps_len, uint8_t n_ap, enum bt_conn_le_cs_role role);

#endif
```

## include/logic_main.h
```c
#ifndef LOGIC_MAIN_H
#define LOGIC_MAIN_H

#include <zephyr/sys/byteorder.h>

#define LOGIC_THREAD_PRIORITY 13
#define LOGIC_THREAD_STACK_SIZE 8192

enum message_type
{
    MESSAGE_NONE = 0,
    MESSAGE_START_ADV,
    MESSAGE_SETUP_DEVICE,
    MESSAGE_COUNT

};

typedef struct
{
    uint8_t event;
    uint8_t value;
} __attribute__((aligned(2))) message_object;

typedef void (*logic_cb)(uint8_t value);

void logic_thread_init(void);
int send_message(enum message_type message, int value);

#endif
```

## src/connected_cs_initiator.c
```c
/*
 * Copyright (c) 2024 Nordic Semiconductor ASA
 *
 * SPDX-License-Identifier: Apache-2.0
 */

#include <math.h>
#include <zephyr/sys/byteorder.h>
#include <zephyr/bluetooth/bluetooth.h>
#include <zephyr/bluetooth/cs.h>
#include <zephyr/bluetooth/att.h>
#include <zephyr/bluetooth/gatt.h>
#include "distance_estimation.h"
#include "common.h"
#include "bluetooth/bluetooth_global.h"
#include "bluetooth/bluetooth_initiator.h"

#define CS_CONFIG_ID     0
#define NUM_MODE_0_STEPS 1

static struct bt_conn *connection;

int main(void)
{
	int err;
	struct k_sem* sem_connected = get_sem_connected();

	printk("Starting Channel Sounding Demo init\n");

	/* Initialize the Bluetooth Subsystem */
	ble_init();

	err = register_step_data_gatt_service();
	if (err) {
		printk("bt_gatt_service_register() returned err %d\n", err);
		return 0;
	}

	err = start_bt_scan();
	if (err) {
		printk("Scanning failed to start (err %d)\n", err);
		return 0;
	}

	k_sem_take(sem_connected, K_FOREVER);
	printk("After sem connected \n");
	connection = get_bt_connection();

	err = get_bt_le_cs_default_settings(false, connection);
	if (err) {
		printk("Failed to configure default CS settings (err %d)\n", err);
	}

	err = setup_initiator(connection);
	if (err) {
		printk("Failed to setup initiator (err %d)\n", err);
	}

	err = act_as_initiator();

	return 0;
}
```

## src/connected_cs_reflector.c
```c
/*
 * Copyright (c) 2024 Nordic Semiconductor ASA
 *
 * SPDX-License-Identifier: Apache-2.0
 */

#include <math.h>
#include <zephyr/sys/byteorder.h>
#include <zephyr/bluetooth/bluetooth.h>
#include <zephyr/bluetooth/cs.h>
#include <zephyr/bluetooth/att.h>
#include <zephyr/bluetooth/gatt.h>
#include "distance_estimation.h"
#include "common.h"
#include "bluetooth/bluetooth_global.h"
#include "bluetooth/bluetooth_reflector.h"

static struct bt_conn *connection;

int main(void)
{
	int err;
	struct bt_gatt_discover_params* discover_params;

	struct k_sem* sem_discovered = get_sem_discovered();
	struct k_sem* sem_connected = get_sem_connected();
	struct k_sem* sem_config_created = get_sem_config_created();

	printk("Starting Channel Sounding Demo reflect\n");

	ble_init();

	k_sem_take(sem_connected, K_FOREVER);

	connection = get_bt_connection();
	
	err = get_bt_le_cs_default_settings(true, connection);
	if (err) {
		printk("Failed to configure default CS settings (err %d)\n", err);
	}

	k_sem_take(sem_config_created, K_FOREVER);

	discover_params = get_discover_params();

	err = bt_gatt_discover(connection, discover_params);
	if (err) {
		printk("Discovery failed (err %d)\n", err);
		return 0;
	}

	err = k_sem_take(sem_discovered, K_SECONDS(10));
	if (err) {
		printk("Timed out during GATT discovery\n");
		return 0;
	}

	err = act_as_reflector(connection);
	
	return 0;
}
```

## src/distance_estimation.c
```c
/*
 * Copyright (c) 2024 Nordic Semiconductor ASA
 *
 * SPDX-License-Identifier: Apache-2.0
 */

#include <math.h>
#include <zephyr/bluetooth/cs.h>
#include <zephyr/logging/log.h>
#include <zephyr/logging/log.h>
#include "distance_estimation.h"

#define CS_FREQUENCY_MHZ(ch)    (2402u + 1u * (ch))
#define CS_FREQUENCY_HZ(ch)     (CS_FREQUENCY_MHZ(ch) * 1000000.0f)
#define SPEED_OF_LIGHT_M_PER_S  (299792458.0f)
#define SPEED_OF_LIGHT_NM_PER_S (SPEED_OF_LIGHT_M_PER_S / 1000000000.0f)
#define PI                      3.14159265358979323846f
#define MAX_NUM_SAMPLES         256

LOG_MODULE_REGISTER(estimator);

struct iq_sample_and_channel {
	bool failed;
	uint8_t channel;
	uint8_t antenna_permutation;
	struct bt_le_cs_iq_sample local_iq_sample;
	struct bt_le_cs_iq_sample peer_iq_sample;
};

struct rtt_timing {
	bool failed;
	int16_t toa_tod_initiator;
	int16_t tod_toa_reflector;
};

static struct iq_sample_and_channel mode_2_data[MAX_NUM_SAMPLES];
static struct rtt_timing mode_1_data[MAX_NUM_SAMPLES];

struct processing_context {
	bool local_steps;
	uint8_t mode_1_data_index;
	uint8_t mode_2_data_index;
	uint8_t n_ap;
	enum bt_conn_le_cs_role role;
};

static void calc_complex_product(int32_t z_a_real, int32_t z_a_imag, int32_t z_b_real,
				 int32_t z_b_imag, int32_t *z_out_real, int32_t *z_out_imag)
{
	*z_out_real = z_a_real * z_b_real - z_a_imag * z_b_imag;
	*z_out_imag = z_a_real * z_b_imag + z_a_imag * z_b_real;
}

static float linear_regression(float *x_values, float *y_values, uint8_t n_samples)
{
	if (n_samples == 0) {
		return 0.0;
	}

	/* Estimates b in y = a + b x */

	float y_mean = 0.0;
	float x_mean = 0.0;

	for (uint8_t i = 0; i < n_samples; i++) {
		y_mean += (y_values[i] - y_mean) / (i + 1);
		x_mean += (x_values[i] - x_mean) / (i + 1);
	}

	float b_est_upper = 0.0;
	float b_est_lower = 0.0;

	for (uint8_t i = 0; i < n_samples; i++) {
		b_est_upper += (x_values[i] - x_mean) * (y_values[i] - y_mean);
		b_est_lower += (x_values[i] - x_mean) * (x_values[i] - x_mean);
	}

	return b_est_upper / b_est_lower;
}

static void bubblesort_2(float *array1, float *array2, uint16_t len)
{
	bool swapped;
	float temp;

	for (uint16_t i = 0; i < len - 1; i++) {
		swapped = false;
		for (uint16_t j = 0; j < len - i - 1; j++) {
			if (array1[j] > array1[j + 1]) {
				temp = array1[j];
				array1[j] = array1[j + 1];
				array1[j + 1] = temp;
				temp = array2[j];
				array2[j] = array2[j + 1];
				array2[j + 1] = temp;
				swapped = true;
			}
		}

		if (!swapped) {
			break;
		}
	}
}

static float estimate_distance_using_phase_slope(struct iq_sample_and_channel *data, uint8_t len)
{
	int32_t combined_i;
	int32_t combined_q;
	uint16_t num_angles = 0;
	static float theta[MAX_NUM_SAMPLES];
	static float frequencies[MAX_NUM_SAMPLES];

	for (uint8_t i = 0; i < len; i++) {
		if (!data[i].failed) {
			calc_complex_product(data[i].local_iq_sample.i, data[i].local_iq_sample.q,
					     data[i].peer_iq_sample.i, data[i].peer_iq_sample.q,
					     &combined_i, &combined_q);

			theta[num_angles] = atan2(1.0 * combined_q, 1.0 * combined_i);
			frequencies[num_angles] = 1.0 * CS_FREQUENCY_MHZ(data[i].channel);
			num_angles++;
		}
	}

	if (num_angles < 2) {
		return 0.0;
	}

	/* Sort phases by tone frequency */
	bubblesort_2(frequencies, theta, num_angles);

	/* One-dimensional phase unwrapping */
	for (uint8_t i = 1; i < num_angles; i++) {
		float difference = theta[i] - theta[i - 1];

		if (difference > PI) {
			for (uint8_t j = i; j < num_angles; j++) {
				theta[j] -= 2.0f * PI;
			}
		} else if (difference < -PI) {
			for (uint8_t j = i; j < num_angles; j++) {
				theta[j] += 2.0f * PI;
			}
		}
	}

	float phase_slope = linear_regression(frequencies, theta, num_angles);

	float distance = -phase_slope * (SPEED_OF_LIGHT_M_PER_S / (4 * PI));

	return distance / 1000000.0f; /* Scale to meters. */
}

static float estimate_distance_using_time_of_flight(uint8_t n_samples)
{
	float tof;
	float tof_mean = 0.0;

	/* Cumulative Moving Average */
	for (uint8_t i = 0; i < n_samples; i++) {
		if (!mode_1_data[i].failed) {
			tof = (mode_1_data[i].toa_tod_initiator -
			       mode_1_data[i].tod_toa_reflector) /
			      2;
			tof_mean += (tof - tof_mean) / (i + 1);
		}
	}

	float tof_mean_ns = tof_mean / 2.0f;

	return tof_mean_ns * SPEED_OF_LIGHT_NM_PER_S;
}

static bool process_step_data(struct bt_le_cs_subevent_step *step, void *user_data)
{
	struct processing_context *context = (struct processing_context *)user_data;

	if (step->mode == BT_CONN_LE_CS_MAIN_MODE_2) {
		struct bt_hci_le_cs_step_data_mode_2 *step_data =
			(struct bt_hci_le_cs_step_data_mode_2 *)step->data;

		if (context->local_steps) {
			for (uint8_t i = 0; i < (context->n_ap + 1); i++) {
				if (step_data->tone_info[i].extension_indicator !=
				    BT_HCI_LE_CS_NOT_TONE_EXT_SLOT) {
					continue;
				}

				mode_2_data[context->mode_2_data_index].channel = step->channel;
				mode_2_data[context->mode_2_data_index].antenna_permutation =
					step_data->antenna_permutation_index;
				mode_2_data[context->mode_2_data_index].local_iq_sample =
					bt_le_cs_parse_pct(
						step_data->tone_info[i].phase_correction_term);
				if (step_data->tone_info[i].quality_indicator ==
					    BT_HCI_LE_CS_TONE_QUALITY_LOW ||
				    step_data->tone_info[i].quality_indicator ==
					    BT_HCI_LE_CS_TONE_QUALITY_UNAVAILABLE) {
					mode_2_data[context->mode_2_data_index].failed = true;
				}

				context->mode_2_data_index++;
			}
		} else {
			for (uint8_t i = 0; i < (context->n_ap + 1); i++) {
				if (step_data->tone_info[i].extension_indicator !=
				    BT_HCI_LE_CS_NOT_TONE_EXT_SLOT) {
					continue;
				}

				mode_2_data[context->mode_2_data_index].peer_iq_sample =
					bt_le_cs_parse_pct(
						step_data->tone_info[i].phase_correction_term);
				if (step_data->tone_info[i].quality_indicator ==
					    BT_HCI_LE_CS_TONE_QUALITY_LOW ||
				    step_data->tone_info[i].quality_indicator ==
					    BT_HCI_LE_CS_TONE_QUALITY_UNAVAILABLE) {
					mode_2_data[context->mode_2_data_index].failed = true;
				}

				context->mode_2_data_index++;
			}
		}
	} else if (step->mode == BT_HCI_OP_LE_CS_MAIN_MODE_1) {
		struct bt_hci_le_cs_step_data_mode_1 *step_data =
			(struct bt_hci_le_cs_step_data_mode_1 *)step->data;

		if (step_data->packet_quality_aa_check !=
			    BT_HCI_LE_CS_PACKET_QUALITY_AA_CHECK_SUCCESSFUL ||
		    step_data->packet_rssi == BT_HCI_LE_CS_PACKET_RSSI_NOT_AVAILABLE ||
		    step_data->tod_toa_reflector == BT_HCI_LE_CS_TIME_DIFFERENCE_NOT_AVAILABLE) {
			mode_1_data[context->mode_1_data_index].failed = true;
		}

		if (context->local_steps) {
			if (context->role == BT_CONN_LE_CS_ROLE_INITIATOR) {
				mode_1_data[context->mode_1_data_index].toa_tod_initiator =
					step_data->toa_tod_initiator;
			} else if (context->role == BT_CONN_LE_CS_ROLE_REFLECTOR) {
				mode_1_data[context->mode_1_data_index].tod_toa_reflector =
					step_data->tod_toa_reflector;
			}
		} else {
			if (context->role == BT_CONN_LE_CS_ROLE_INITIATOR) {
				mode_1_data[context->mode_1_data_index].tod_toa_reflector =
					step_data->tod_toa_reflector;
			} else if (context->role == BT_CONN_LE_CS_ROLE_REFLECTOR) {
				mode_1_data[context->mode_1_data_index].toa_tod_initiator =
					step_data->toa_tod_initiator;
			}
		}

		context->mode_1_data_index++;
	}

	return true;
}

void estimate_distance(uint8_t *local_steps, uint16_t local_steps_len, uint8_t *peer_steps,
		       uint16_t peer_steps_len, uint8_t n_ap, enum bt_conn_le_cs_role role)
{
	struct net_buf_simple buf;

	struct processing_context context = {
		.local_steps = true,
		.mode_1_data_index = 0,
		.mode_2_data_index = 0,
		.n_ap = n_ap,
		.role = role,
	};

	memset(mode_1_data, 0, sizeof(mode_1_data));
	memset(mode_2_data, 0, sizeof(mode_2_data));

	net_buf_simple_init_with_data(&buf, local_steps, local_steps_len);

	bt_le_cs_step_data_parse(&buf, process_step_data, &context);

	context.mode_1_data_index = 0;
	context.mode_2_data_index = 0;
	context.local_steps = false;

	net_buf_simple_init_with_data(&buf, peer_steps, peer_steps_len);

	bt_le_cs_step_data_parse(&buf, process_step_data, &context);

	float phase_slope_based_distance =
		estimate_distance_using_phase_slope(mode_2_data, context.mode_2_data_index);

	float rtt_based_distance =
		estimate_distance_using_time_of_flight(context.mode_1_data_index);

	if (rtt_based_distance == 0.0f && phase_slope_based_distance == 0.0f) {
		LOG_INF("A reliable distance estimate could not be computed.");
	} else {
		LOG_INF("Estimated distance to reflector:");
	}

	if (rtt_based_distance != 0.0f) {
		LOG_INF("- Round-Trip Timing method: %f meters (derived from %d samples)",
		       (double)rtt_based_distance, context.mode_1_data_index);
	}
	if (phase_slope_based_distance != 0.0f) {
		LOG_INF("- Phase-Based Ranging method: %f meters (derived from %d samples)",
		       (double)phase_slope_based_distance, context.mode_2_data_index);
	}
}
```
